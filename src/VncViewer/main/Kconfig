## src/VncViewer/main/Kconfig
```kconfig
menu "Board Config (GUITION JC-4880P443)"

    choice BSP_LCD_COLOR_FORMAT
        prompt "LCD color format"
        default BSP_LCD_COLOR_FORMAT_RGB565
        
        config BSP_LCD_COLOR_FORMAT_RGB565
            bool "RGB565"
        config BSP_LCD_COLOR_FORMAT_RGB888
            bool "RGB888"
    endchoice

    config BSP_LCD_WIDTH
        int "LCD Width"
        default 480

    config BSP_LCD_HEIGHT
        int "LCD Height"
        default 800

    config BSP_LCD_DPI_CLK
        int "LCD DPI Clock"
        default 34

    config BSP_LCD_HSYNC
        int "LCD HSync"
        default 12

    config BSP_LCD_HBP
        int "LCD HBP"
        default 42

    config BSP_LCD_HFP
        int "LCD HFP"
        default 42

    config BSP_LCD_VSYNC
        int "LCD VSync"
        default 2

    config BSP_LCD_VBP
        int "LCD VBP"
        default 8

    config BSP_LCD_VFP
        int "LCD VFP"
        default 166

    config BSP_LCD_RST_PIN 
        int "LCD_RST_PIN "
        default 5

    config BSP_LCD_BKLIGHT_PIN
        int "LCD_BKLIGHT_PIN"
        default 23

    config BSP_MIPI_DSI_LANE_NUM
        int "MIPI_DSI_LANE_NUM"
        default 2

    config BSP_MIPI_DSI_LANE_RATE
        int "MIPI_DSI_LANE_RATE"
        default 1000

    config BSP_MIPI_PHY_LDO_CHAN
        int "MIPI_PHY_LDO_CHAN"
        default 3

    config BSP_MIPI_PHY_LDO_MV
        int "MIPI_PHY_LDO_MV"
        default 2500

    config BSP_TOUCH_I2C_SDA
        int "TOUCH_I2C_SDA"
        default 7

    config BSP_TOUCH_I2C_SCL
        int "TOUCH_I2C_SCL"
        default 8

    config BSP_TOUCH_I2C_SPEED
        int "TOUCH_I2C_SPEED"
        default 400000

    config BSP_TOUCH_RST
        int "TOUCH_RST"
        default 22

    config BSP_TOUCH_INT
        int "TOUCH_INT"
        default 21

    config BSP_DISPLAY_BRIGHTNESS_LEDC_CH
        int "LEDC channel index"
        default 1
        range 0 7
        help
            LEDC channel is used to generate PWM signal that controls display brightness.
            Set LEDC index that should be used.
endmenu
```

## src/VncViewer/sdkconfig.defaults
```kconfig
#
CONFIG_IDF_TARGET="esp32p4"
CONFIG_ESP32P4_SELECTS_REV_LESS_V3=y
CONFIG_ESP32P4_REV_MIN_100=y
CONFIG_CACHE_L2_CACHE_256KB=y
CONFIG_CACHE_L2_CACHE_LINE_128B=y

CONFIG_ESPTOOLPY_FLASHMODE_QIO=y
CONFIG_ESPTOOLPY_FLASHSIZE_16MB=y
CONFIG_SPI_FLASH_SUPPORT_BOYA_CHIP=y

CONFIG_PARTITION_TABLE_CUSTOM=y
CONFIG_PARTITION_TABLE_OFFSET=0x10000

#
CONFIG_SPIRAM=y
CONFIG_SPIRAM_MODE_HEX=y
CONFIG_SPIRAM_SPEED_200M=y
CONFIG_SPIRAM_XIP_FROM_PSRAM=y

#
CONFIG_COMPILER_OPTIMIZATION_PERF=y
CONFIG_ESP_MAIN_TASK_STACK_SIZE=10240
CONFIG_FREERTOS_HZ=100

CONFIG_ESP_CONSOLE_USB_SERIAL_JTAG=y
CONFIG_LOG_DEFAULT_LEVEL_INFO=y


#
CONFIG_LV_FONT_MONTSERRAT_12=y
CONFIG_LV_FONT_MONTSERRAT_14=y
CONFIG_LV_FONT_MONTSERRAT_16=y
CONFIG_LV_FONT_MONTSERRAT_18=y
CONFIG_LV_FONT_MONTSERRAT_26=y
CONFIG_LV_FONT_MONTSERRAT_32=y
CONFIG_LV_FONT_DEFAULT_MONTSERRAT_18=y
CONFIG_LV_USE_OBJ_NAME=y
```

## src/VncViewer_SDL-LVGL/Kconfig
```kconfig
mainmenu "LVGL Static Library Project Configuration"

menu "Application Settings"
endmenu

source "lvgl/Kconfig"
```

## test/BoardTest/sdkconfig.defaults
```kconfig
# Target
CONFIG_IDF_TARGET="esp32p4"
CONFIG_ESPTOOLPY_FLASHMODE_QIO=y
CONFIG_ESPTOOLPY_FLASHSIZE_16MB=y
CONFIG_PARTITION_TABLE_CUSTOM=y
CONFIG_COMPILER_OPTIMIZATION_PERF=y

# PSRAM: 32MB HEX mode, 200MHz
CONFIG_SPIRAM=y
CONFIG_SPIRAM_MODE_HEX=y
CONFIG_SPIRAM_SPEED_200M=y
CONFIG_SPIRAM_XIP_FROM_PSRAM=y

# Parition Table
CONFIG_PARTITION_TABLE_OFFSET=0x10000

# Maximum Supported ESP32-P4 Revision (Rev v1.99)
CONFIG_ESP32P4_SELECTS_REV_LESS_V3=y
CONFIG_ESP32P4_REV_MIN_100=y
#CONFIG_ESP32P4_REV_MIN_FULL=100
#CONFIG_ESP_REV_MIN_FULL=100
#CONFIG_ESP32P4_REV_MAX_FULL=199
#CONFIG_ESP_REV_MAX_FULL=199

# USB Serial/JTAG
CONFIG_ESP_CONSOLE_USB_SERIAL_JTAG=y

# Log level
CONFIG_LOG_DEFAULT_LEVEL_INFO=y

#
CONFIG_CACHE_L2_CACHE_256KB=y
CONFIG_CACHE_L2_CACHE_LINE_128B=y
CONFIG_ESP_MAIN_TASK_STACK_SIZE=10240

#
CONFIG_ESP_HOSTED=y
CONFIG_SLAVE_IDF_TARGET_ESP32C6=y

# WiFi Remote buffer config (needed by WIFI_INIT_CONFIG_DEFAULT)
#CONFIG_WIFI_RMT_STA_CONNECT_TIMEOUT_MS=10000
#CONFIG_WIFI_RMT_TX_BUFFER_NUM=16
#CONFIG_WIFI_RMT_RX_MGMT_BUF_NUM=5
CONFIG_WIFI_RMT_STATIC_RX_BUFFER_NUM=10
CONFIG_WIFI_RMT_DYNAMIC_RX_BUFFER_NUM=32
CONFIG_WIFI_RMT_TX_BUFFER_TYPE=1
CONFIG_WIFI_RMT_DYNAMIC_TX_BUFFER_NUM=32
CONFIG_WIFI_RMT_DYNAMIC_RX_MGMT_BUF=32
CONFIG_WIFI_RMT_ESPNOW_MAX_ENCRYPT_NUM=0
CONFIG_WIFI_RMT_AMPDU_RX_ENABLED=y
CONFIG_WIFI_RMT_AMPDU_TX_ENABLED=y
CONFIG_FREERTOS_HZ=1000
CONFIG_FREERTOS_VTASKLIST_INCLUDE_COREID=y
CONFIG_FREERTOS_GENERATE_RUN_TIME_STATS=y


#CONFIG_IDF_EXPERIMENTAL_FEATURES=y
#CONFIG_CODEC_I2C_BACKWARD_COMPATIBLE=n
```

## test/LvglTest/sdkconfig.defaults
```kconfig
#
CONFIG_IDF_TARGET="esp32p4"
CONFIG_ESPTOOLPY_FLASHMODE_QIO=y
CONFIG_ESPTOOLPY_FLASHSIZE_16MB=y
CONFIG_COMPILER_OPTIMIZATION_PERF=y
CONFIG_PARTITION_TABLE_CUSTOM=y
CONFIG_PARTITION_TABLE_OFFSET=0x10000

#
CONFIG_SPIRAM=y
CONFIG_SPIRAM_MODE_HEX=y
CONFIG_SPIRAM_SPEED_200M=y
CONFIG_SPIRAM_XIP_FROM_PSRAM=y

#
CONFIG_ESP32P4_SELECTS_REV_LESS_V3=y
CONFIG_ESP32P4_REV_MIN_100=y

#
CONFIG_AUTOSTART_ARDUINO=n
CONFIG_FREERTOS_HZ=1000
CONFIG_ESP_CONSOLE_USB_SERIAL_JTAG=y
CONFIG_LOG_DEFAULT_LEVEL_INFO=y
CONFIG_CACHE_L2_CACHE_256KB=y
CONFIG_CACHE_L2_CACHE_LINE_128B=y
CONFIG_ESP_MAIN_TASK_STACK_SIZE=10240
```

## test/VncClient/sdkconfig.defaults
```kconfig
CONFIG_BLINK_LED_GPIO=y
CONFIG_BLINK_GPIO=8

CONFIG_AUTOSTART_ARDUINO=y
CONFIG_ARDUINO_USB_MODE=1
CONFIG_ARDUINO_USB_CDC_ON_BOOT=1

CONFIG_FREERTOS_HZ=1000


CONFIG_IDF_TARGET="esp32p4"
CONFIG_ESPTOOLPY_FLASHMODE_QIO=y
CONFIG_ESPTOOLPY_FLASHSIZE_16MB=y
#CONFIG_PARTITION_TABLE_CUSTOM=y
CONFIG_COMPILER_OPTIMIZATION_PERF=y
CONFIG_PARTITION_TABLE_CUSTOM=y

CONFIG_SPIRAM=y
CONFIG_SPIRAM_MODE_HEX=y
CONFIG_SPIRAM_SPEED_200M=y
CONFIG_SPIRAM_XIP_FROM_PSRAM=y

CONFIG_ESP32P4_SELECTS_REV_LESS_V3=y
CONFIG_ESP32P4_REV_MIN_100=y

CONFIG_PARTITION_TABLE_OFFSET=0x10000

CONFIG_ESP_CONSOLE_USB_SERIAL_JTAG=y

CONFIG_LOG_DEFAULT_LEVEL_INFO=y

CONFIG_CACHE_L2_CACHE_256KB=y
CONFIG_CACHE_L2_CACHE_LINE_128B=y
CONFIG_ESP_MAIN_TASK_STACK_SIZE=10240
```
